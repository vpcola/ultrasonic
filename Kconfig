## Kconfig
```kconfig
menu "Ultrasonic Sensor"

    config ULTRASONICSENSOR_TASK_STACK_SIZE
        int "ULTRASONICSENSOR Task Stack Size"
        range 0 4096
        default 2048
        help
            Stack size of ULTRASONICSENSOR task.

    config ULTRASONICSENSOR_TASK_PRIORITY
        int "ULTRASONICSENSOR Parser Task Priority"
        range 0 24
        default 2
        help
            Priority of ULTRASONICSENSOR task.

endmenu
```
